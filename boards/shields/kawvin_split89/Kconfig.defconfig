## boards/shields/kawvin_split89/Kconfig.defconfig
```kconfig
# Copyright (c) 2023 The ZMK Contributors
# SPDX-License-Identifier: MIT

if SHIELD_KAWVIN_SPLIT89_CENTRAL_DONGLE_NODISPLAY || SHIELD_KAWVIN_SPLIT89_CENTRAL_DONGLE || SHIELD_KAWVIN_SPLIT89_CENTRAL_LEFT

config ZMK_KEYBOARD_NAME
    default "Kawvin_Split89"

config ZMK_SPLIT_ROLE_CENTRAL
    default y

endif

#if SHIELD_KAWVIN_SPLIT89_CENTRAL_DONGLE_NODISPLAY || SHIELD_KAWVIN_SPLIT89_CENTRAL_DONGLE

#CONFIG_ZMK_IS_DONGLE_MODE
#    default y

#endif

if SHIELD_KAWVIN_SPLIT89_CENTRAL_DONGLE_NODISPLAY || SHIELD_KAWVIN_SPLIT89_CENTRAL_DONGLE || SHIELD_KAWVIN_SPLIT89_CENTRAL_LEFT || SHIELD_KAWVIN_SPLIT89_PERIPHERAL_LEFT_NODISPLAY || SHIELD_KAWVIN_SPLIT89_PERIPHERAL_LEFT || SHIELD_KAWVIN_SPLIT89_PERIPHERAL_RIGHT

config ZMK_SPLIT
    default y

endif



if SHIELD_KAWVIN_SPLIT89_CENTRAL_LEFT || SHIELD_KAWVIN_SPLIT89_PERIPHERAL_LEFT_NODISPLAY || SHIELD_KAWVIN_SPLIT89_PERIPHERAL_LEFT || SHIELD_KAWVIN_SPLIT89_PERIPHERAL_RIGHT

config ZMK_RGB_UNDERGLOW
    select WS2812_STRIP
    select SPI

endif



if ZMK_DISPLAY

config SSD1306
    default y

config I2C
    default y

choice ZMK_DISPLAY_WORK_QUEUE
    default ZMK_DISPLAY_WORK_QUEUE_DEDICATED
endchoice

endif # ZMK_DISPLAY



if LVGL

config LV_Z_VDB_SIZE
    default 64

config LV_DPI_DEF
    default 148

config LV_Z_BITS_PER_PIXEL
    default 1

choice LV_COLOR_DEPTH
    default LV_COLOR_DEPTH_1
endchoice

endif # LVGL
```

## boards/shields/kawvin_split89/Kconfig.shield
```kconfig
# Copyright (c) 2023 The ZMK Contributors
# SPDX-License-Identifier: MIT

config SHIELD_KAWVIN_SPLIT89_LEFT
    def_bool $(shields_list_contains,kawvin_split89_left)

config SHIELD_KAWVIN_SPLIT89_RIGHT
    def_bool $(shields_list_contains,kawvin_split89_right)
```

## boards/shields/kawvin_split89_dongle/Kconfig.shield
```kconfig
# Copyright (c) 2023 The ZMK Contributors
# SPDX-License-Identifier: MIT

config SHIELD_KAWVIN_SPLIT89_DONGLE_DONGLE
    def_bool $(shields_list_contains,kawvin_split89_dongle_dongle)

config SHIELD_KAWVIN_SPLIT89_DONGLE_LEFT
    def_bool $(shields_list_contains,kawvin_split89_dongle_left)

config SHIELD_KAWVIN_SPLIT89_DONGLE_RIGHT
    def_bool $(shields_list_contains,kawvin_split89_dongle_right)
```

## boards/shields/kawvin_split89_dongle_display/Kconfig.shield
```kconfig
# Copyright (c) 2023 The ZMK Contributors
# SPDX-License-Identifier: MIT

config SHIELD_KAWVIN_SPLIT89_DONGLE_DISPLAY_DONGLE
    def_bool $(shields_list_contains,kawvin_split89_dongle_display_dongle)

config SHIELD_KAWVIN_SPLIT89_DONGLE_DISPLAY_LEFT
    def_bool $(shields_list_contains,kawvin_split89_dongle_display_left)

config SHIELD_KAWVIN_SPLIT89_DONGLE_DISPLAY_RIGHT
    def_bool $(shields_list_contains,kawvin_split89_dongle_display_right)
```
